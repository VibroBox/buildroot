## package/pbzip2/Config.in
```kconfig
config BR2_PACKAGE_PBZIP2
	bool "pbzip2"
	help
	  PBZIP2 is a parallel implementation of the bzip2 block-sorting 
	  file compressor that uses pthreads and achieves 
	  near-linear speedup on SMP machines. 

	  http://compression.ca/pbzip2
```

## package/python-pycurl/Config.in
```kconfig
config BR2_PACKAGE_PYTHON_PYCURL
	bool "python-pycurl"
	help
	  PycURL is a Python interface to libcurl.

	  http://pycurl.io/
```

## package/vibrodata/Config.in
```kconfig
config BR2_PACKAGE_VIBRODATA
	bool "Vibrodata"
	depends on BR2_arm
	help
	  Vibrodata software

if BR2_PACKAGE_VIBRODATA
config BR2_PACKAGE_VIBRODATA_OPY
	bool "Obfuscate Python code"
	help
	  Obfuscate vibrodata python code by using Opy
endif
```
